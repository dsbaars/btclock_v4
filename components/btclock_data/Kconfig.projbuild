## components/btclock_fs/Kconfig.projbuild
```kconfig
menu "BTClock PoC LittleFS"

config BTCLOCK_LITTLEFS_SELFTEST
    bool "Run a boot-time LittleFS self-test"
    default n
    help
        When enabled, the boot path writes a small file to the LittleFS
        partition, reads it back, asserts the contents match, and
        deletes it. Intended as a smoke test for the FS port — leave
        off in normal builds; flip on with `idf.py menuconfig` or set
        `CONFIG_BTCLOCK_LITTLEFS_SELFTEST=y` in
        `sdkconfig.defaults.<variant>` when bringing up a new board
        or partition layout.

endmenu
```

## components/wifi/Kconfig.projbuild
```kconfig
menu "BTClock PoC WiFi"

config POC_WIFI_SSID
    string "WiFi SSID"
    default ""
    help
        WiFi SSID to connect to. Set with `idf.py menuconfig`; the sdkconfig
        file is gitignored so credentials don't end up in the repo.

config POC_WIFI_PASSWORD
    string "WiFi password"
    default ""
    help
        WPA2-PSK password for POC_WIFI_SSID. Leave empty for open networks.

endmenu
```
